## sdkconfig.defaults
```kconfig
# ============================================================
# sdkconfig.defaults — Thermal Door Detector (ESP32-S3)
# ============================================================
# Modify here to change the build configuration.
# Perform a fullclean from the IDE after changes here.

# --- FreeRTOS ---
CONFIG_FREERTOS_HZ=1000
CONFIG_FREERTOS_ENABLE_STATIC_TASK_CLEAN_UP=y

# --- Watchdog ---
CONFIG_ESP_TASK_WDT_EN=y
CONFIG_ESP_TASK_WDT_TIMEOUT_S=5

# --- OTA Rollback (anti-bootloop) ---
# If the new firmware crashes before calling esp_ota_mark_app_valid_cancel_rollback(),
# the bootloader automatically reverts to the previous valid partition.
CONFIG_BOOTLOADER_APP_ROLLBACK_ENABLE=y

# --- WiFi ---
CONFIG_ESP_WIFI_SOFTAP_SUPPORT=y
CONFIG_ESP_WIFI_STATIC_RX_BUFFER_NUM=10
CONFIG_ESP_WIFI_DYNAMIC_RX_BUFFER_NUM=32

# --- HTTP Server (WebSocket) ---
CONFIG_HTTPD_WS_SUPPORT=y

# --- LWIP (sockets) ---
CONFIG_LWIP_UDP_RECVMBOX_SIZE=16
CONFIG_LWIP_SO_RCVBUF=y
CONFIG_LWIP_TCP_SND_BUF_DEFAULT=5744
CONFIG_LWIP_TCP_WND_DEFAULT=5744

# --- Logging (INFO in production — less noise in monitor) ---
# CONFIG_LOG_DEFAULT_LEVEL_DEBUG=y
CONFIG_LOG_DEFAULT_LEVEL_INFO=y

# --- Main loop stack size ---
# Increased to 8KB (from 6KB) for Picolibc safety in ESP-IDF 6.0.
CONFIG_ESP_MAIN_TASK_STACK_SIZE=8192

# --- I2C (use native driver, not legacy) ---
CONFIG_I2C_ENABLE_DEBUG_LOG=n

# --- Target Device ---
CONFIG_IDF_TARGET="esp32s3"

# --- Custom Partitions for OTA ---
CONFIG_PARTITION_TABLE_CUSTOM=y
CONFIG_PARTITION_TABLE_CUSTOM_FILENAME="partitions.csv"
CONFIG_PARTITION_TABLE_FILENAME="partitions.csv"

# --- Configuración Temporal para Migración ESP-IDF 6.0 ---
CONFIG_COMPILER_DISABLE_DEFAULT_ERRORS=n
```
